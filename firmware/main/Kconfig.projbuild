## firmware/main/Kconfig.projbuild
```kconfig
menu "Desk Monitor"

    config DESK_WIFI_SSID
        string "Wi-Fi SSID"
        default ""

    config DESK_WIFI_PASSWORD
        string "Wi-Fi password"
        default ""

    config DESK_API_BASE_URL
        string "Backend API base URL"
        default "https://monitor.danielalbertorosso.com.ar/api/v1"

    config DESK_DEVICE_ID
        string "Device id (as provisioned in the fleet console)"
        default ""

    config DESK_DEVICE_SECRET
        string "Device one-time secret (from the fleet console credentials file)"
        default ""

endmenu
```

## firmware/sdkconfig.defaults
```kconfig
CONFIG_IDF_TARGET="esp32c6"
CONFIG_COMPILER_OPTIMIZATION_SIZE=y
CONFIG_LOG_DEFAULT_LEVEL_INFO=y
CONFIG_MQTT_PROTOCOL_5=y
CONFIG_ESP_MAIN_TASK_STACK_SIZE=16384
CONFIG_LV_USE_ST7789=y
CONFIG_ESPTOOLPY_FLASHSIZE_8MB=y
CONFIG_MBEDTLS_CERTIFICATE_BUNDLE_CROSS_SIGNED_VERIFY=y
CONFIG_PARTITION_TABLE_CUSTOM=y
CONFIG_PARTITION_TABLE_CUSTOM_FILENAME="partitions.csv"
```
